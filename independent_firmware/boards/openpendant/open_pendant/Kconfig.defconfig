## independent_firmware/boards/openpendant/open_pendant/Kconfig.defconfig
```kconfig
# SPDX-License-Identifier: Apache-2.0

if BOARD_OPEN_PENDANT_NRF5340_CPUAPP

config BT_HCI_IPC
	default y if BT_HCI

config HEAP_MEM_POOL_ADD_SIZE_BOARD
	int
	default 4096 if BT_HCI_IPC

endif
```

## independent_firmware/boards/openpendant/open_pendant/Kconfig.open_pendant
```kconfig
# SPDX-License-Identifier: Apache-2.0

config BOARD_OPEN_PENDANT
	select SOC_NRF5340_CPUAPP_QKAA if BOARD_OPEN_PENDANT_NRF5340_CPUAPP
	select SOC_NRF5340_CPUNET_QKAA if BOARD_OPEN_PENDANT_NRF5340_CPUNET
```

## independent_firmware/boards/openpendant/open_pendant/board.yml
```yaml
board:
  name: open_pendant
  full_name: Open Limitless Pendant
  vendor: others
  socs:
  - name: nrf5340
```
